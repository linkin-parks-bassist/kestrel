## tools/sqlite_probe/main/Kconfig.projbuild
```kconfig
menu "SQLite catalogue probe"
config KT_PROBE_RAW_READ
    bool "Read SQLite pages with lseek/read instead of stdio"
    default n
    help
        Compare the same immutable fixture using direct file descriptor reads.
        This is a read-cost experiment, not a production VFS selection.
config KT_PROBE_DMA_READ
    bool "Read through one aligned internal 4-KiB buffer"
    depends on KT_PROBE_RAW_READ
    default n
    help
        Test whether SQLite page alignment causes single-sector SD transfers.
        The buffer copies reads; it is not a cache or a production allocation policy.
config KT_PROBE_COMPOSED
    bool "Use the multi-axis fixture"
    default n
    help
        Compare ordered membership checks with covering-facet seeds and verify
        complete paged results against an independent C predicate evaluator.
config KT_PROBE_ROWS
    int "Multi-axis fixture effect count"
    range 1 1000000
    default 10000
    help
        Larger fixtures require more construction memory and longer complete walks.
        This changes synthetic scale, not metadata realism or production capacity.
endmenu
```

## tools/sqlite_probe/sdkconfig.defaults
```kconfig
CONFIG_IDF_TARGET="esp32p4"
CONFIG_ESPTOOLPY_FLASHSIZE_2MB=y
CONFIG_PARTITION_TABLE_SINGLE_APP_LARGE=y
CONFIG_COMPILER_OPTIMIZATION_SIZE=y
CONFIG_ESP_MAIN_TASK_STACK_SIZE=16384
CONFIG_SPIRAM=y
CONFIG_IDF_EXPERIMENTAL_FEATURES=y
CONFIG_SPIRAM_MODE_HEX=y
CONFIG_SPIRAM_SPEED_200M=y
CONFIG_SPIRAM_BOOT_INIT=y
CONFIG_SPIRAM_USE_MALLOC=y
CONFIG_SPIRAM_MEMTEST=y
CONFIG_SPIRAM_MALLOC_ALWAYSINTERNAL=16384
CONFIG_SPIRAM_MALLOC_RESERVE_INTERNAL=32768
```
